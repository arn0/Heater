## main/Kconfig.projbuild
```kconfig
menu "Example Configuration"

    config EXAMPLE_ENABLE_LCD
        bool
        prompt "Enable LCD"
        default n
        help
            Use this option to enable LCD display.

    choice EXAMPLE_LCD_CONTROLLER
        prompt "LCD controller model"
        depends on EXAMPLE_ENABLE_LCD
        default EXAMPLE_LCD_CONTROLLER_ILI9341
        help
            Select LCD controller model

        config EXAMPLE_LCD_CONTROLLER_ILI9341
            bool "ILI9341"

        config EXAMPLE_LCD_CONTROLLER_GC9A01
            bool "GC9A01"
    endchoice

    config EXAMPLE_LCD_TOUCH_ENABLED
        bool "Enable LCD touch"
        depends on EXAMPLE_ENABLE_LCD
        default n
        help
            Enable this option if you wish to use display touch. You can select from touch controllers.

    choice EXAMPLE_LCD_TOUCH_CONTROLLER
        prompt "LCD touch controller model"
        depends on EXAMPLE_LCD_TOUCH_ENABLED
        default EXAMPLE_LCD_TOUCH_CONTROLLER_STMPE610
        help
            Select LCD touch controller model

        config EXAMPLE_LCD_TOUCH_CONTROLLER_STMPE610
            bool "STMPE610"
            help
                Touch controller STMPE610 connected via SPI.
    endchoice

    config SNTP_TIME_SERVER
        string "SNTP server name"
        default "pool.ntp.org"
        help
            Hostname of the main SNTP server.

    config EXAMPLE_PEER_ADDR
        string "Peer Address"
        default "ADDR_ANY"
        help
            Enter the peer address in aa:bb:cc:dd:ee:ff form to connect to a specific peripheral

    config EXAMPLE_ENCRYPTION
        bool
        prompt "Enable Link Encryption"
        default y
        help
            This enables bonding and encryption after connection has been established.

    config EXAMPLE_EXTENDED_ADV
        bool
        depends on SOC_BLE_50_SUPPORTED && BT_NIMBLE_50_FEATURE_SUPPORT
        default y if SOC_ESP_NIMBLE_CONTROLLER
        select BT_NIMBLE_EXT_ADV
        prompt "Enable Extended Adv"
        help
            Use this option to enable extended advertising in the example.
            If this option is disabled, ensure config BT_NIMBLE_EXT_ADV is
            also disabled from Nimble stack menuconfig

    config EXAMPLE_ENABLE_STATUS_LOG
        bool
        prompt "Enable status logging"
        default n
        help
            Use this option to enable collecting "heater status" snapshots every minute
            and write 24 hours of data to the file "log.bin" on the SPIFFS data partition.


endmenu
```

## sdkconfig.defaults
```kconfig
CONFIG_LV_USE_USER_DATA=y
CONFIG_LV_COLOR_16_SWAP=y
CONFIG_LV_COLOR_DEPTH_16=y

#CONFIG_FREERTOS_USE_TRACE_FACILITY=y
#CONFIG_FREERTOS_GENERATE_RUN_TIME_STATS=y
#CONFIG_FREERTOS_RUN_TIME_COUNTER_TYPE_U64=y
```
